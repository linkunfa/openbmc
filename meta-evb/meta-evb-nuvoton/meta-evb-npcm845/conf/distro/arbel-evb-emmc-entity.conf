## meta-evb/meta-evb-nuvoton/meta-evb-npcm845/conf/distro/arbel-evb-emmc-entity.conf
```bitbake
require conf/distro/openbmc-phosphor.conf
require conf/distro/include/phosphor-mmc.inc

VIRTUAL-RUNTIME_obmc-inventory-manager = "entity-manager"
VIRTUAL-RUNTIME_obmc-sensors-hwmon = "dbus-sensors"
PREFERRED_PROVIDER_virtual/obmc-inventory-data = "entity-manager"

MACHINE_EXTRA_RRECOMMENDS = "kernel-modules"

DISTRO = "arbel-evb-emmc"
DISTRO_append = "-entity"
DISTRO_NAME = "Nuvoton OpenBMC (Entity Manager)"
DISTRO_FEATURES_append = " ext2"
DISTRO_FEATURES_append = " entity-manager"
DISTRO_FEATURES_append = " ipmi-fru"

# Remove unneeded binaries from image
IMAGE_FEATURES_remove = "obmc-health-monitor"

# eMMC layout
# max uboot image size in SPI partition is 768K
MMC_UBOOT_SIZE = "640"

WKS_FILE ?= "emmc-arbel-evb.wks.in"
WKS_FILE_DEPENDS ?= " \
    virtual/bootloader \
    virtual/kernel \
"
IMAGE_BOOT_FILES ?= "fitImage-${INITRAMFS_IMAGE}-${MACHINE}-${MACHINE};fitImage"
```
